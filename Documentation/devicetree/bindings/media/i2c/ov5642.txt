## Documentation/devicetree/bindings/media/i2c/ov5642.txt
```
* Omnivision OV5642 CMOS sensor

The Omnivision OV5642 is a 1/4" color CMOS QSXGA (5 megapixel) image sensor.
It supports up to 2592x1944 resolution. It also support output YUV422/420,
RGB565/555/444, CCIR656, 8-bit compression or raw RGB data.

Required Properties:
- compatible: should be "ovti,ov5642"
- clocks: reference to the xvclk input clock.
- clock-names: should be "xvclk".

Optional Properties:
- resetb-gpios: reference to the GPIO connected to the resetb pin, if any.
- pwdn-gpios: reference to the GPIO connected to the pwdn pin, if any.

The device node must contain one 'port' child node for its digital output
video port, in accordance with the video interface bindings defined in
Documentation/devicetree/bindings/media/video-interfaces.txt.

Example:

	i2c1: i2c@f0018000 {
		ov5642: camera@0x3c {
			compatible = "ovti,ov5642";
			reg = <0x3c>;

			pinctrl-names = "default";
			pinctrl-0 = <&pinctrl_pck1 &pinctrl_sensor_pwdn &pinctrl_sensor_resetb>;

			resetb-gpios = <&pioE 24 GPIO_ACTIVE_LOW>;
			pwdn-gpios = <&pioE 29 GPIO_ACTIVE_HIGH>;

			clocks = <&pck1>;
			clock-names = "xvclk";

			assigned-clocks = <&pck1>;
			assigned-clock-rates = <25000000>;

			port {
				ov5642_0: endpoint {
					remote-endpoint = <&isi_0>;
					bus-width = <8>;
				};
			};
		};
	};
```

## Documentation/devicetree/bindings/mfd/atmel-flexcom.txt
```
* Device tree bindings for Atmel Flexcom (Flexible Serial Communication Unit)

The Atmel Flexcom is just a wrapper which embeds a SPI controller, an I2C
controller and an USART. Only one function can be used at a time and is chosen
at boot time according to the device tree.

Required properties:
- compatible: "atmel,sama5d2-flexcom"
- reg: shall be the offset/length value for Flexcom dedicated I/O registers
  (without USART, TWI or SPI registers).
- clocks: shall be the Flexcom peripheral clock from PMC.
- #address-cells: should be <1>
- #size-cells: should be <1>
- ranges: one range for the full I/O register region (including USART, TWI and
  SPI registers)
- atmel,flexcom-mode: shall be a string among { "spi", "usart", "i2c", "twi" }.
  "i2c" and "twi" are synonymous.

Required child:
a child device of type matching the "atmel,flexcom-mode" property.
The reg property of this child should be:
- <0x200 0x200> for USART
- <0x400 0x200> for SPI
- <0x600 0x200> for I2C
The phandle provided by the clocks property of the child is the same as one for
the Flexcom parent.
Other properties remain unchanged. See documentation of the respective device.

Example:

flx0: flexcom@f8034000 {
	compatible = "atmel,sama5d2-flexcom";
	reg = <0xf8034000 0x200>;
	clocks = <&flx0_clk>;
	#address-cells = <1>;
	#size-cells = <1>;
	ranges = <0x0 0xf8034000 0x800>;
	atmel,flexcom-mode = "spi";

	spi@f8034400 {
		compatible = "atmel,at91rm9200-spi";
		reg = <0x400 0x200>;
		interrupts = <19 IRQ_TYPE_LEVEL_HIGH 7>;
		pinctrl-names = "default";
		pinctrl-0 = <&pinctrl_flx0_ioset1>;
		#address-cells = <1>;
		#size-cells = <0>;
		clocks = <&flx0_clk>;
		clock-names = "spi_clk";
		atmel,fifo-size = <32>;

		mtd_dataflash@0 {
			compatible = "atmel,at25f512b";
			reg = <0>;
			spi-max-frequency = <20000000>;
		};
	};
};
```

## Documentation/devicetree/bindings/mtd/spansion-nor.txt
```
* Spansion NOR flash

Optional properties:
- spansion,latency-code : Only used when the "m25p,num-dummy-cycles" property is
                          set. The Spansion latency code tells the NOR flash
                          memory the number of dummy cycles to expect for each
                          Fast Read command. The value to be used is provided by
                          tables in the memory datasheet and depends on the SPI
                          clock frequency and on the Single/Dual Data Rate mode.
                          Then the value of "m25p,num-dummy-cycles" property
                          should match the (Fast) Read command to be used for
                          the chosen latency code.

Example:

	m25p80@0 {
		compatible = "spansion,s25fl512s";
		reg = <0>;
		spi-max-frequency = <104000000>;
		m25p,num-dummy-cycles = <8>;
		spansion,latency-code = <2>;
	};
```

## Documentation/devicetree/bindings/regulator/act8865-regulator.txt
```
ACT8865 regulator
-------------------

Required properties:
- compatible: "active-semi,act8865"
- reg: I2C slave address

Example:
--------

	i2c1: i2c@f0018000 {
		status = "okay";

		pmic: act8865@5b {
			compatible = "active-semi,act8865";
			reg = <0x5b>;

			regulators {
				vcc_1v8_reg: DCDC_REG1 {
					regulator-name = "DCDC_REG1";
					regulator-min-microvolt = <1800000>;
					regulator-max-microvolt = <1800000>;
					regulator-always-on;
				};

				vcc_1v2_reg: DCDC_REG2 {
					regulator-name = "DCDC_REG2";
					regulator-min-microvolt = <1100000>;
					regulator-max-microvolt = <1300000>;
					regulator-suspend-mem-microvolt = <1150000>;
					regulator-suspend-standby-microvolt = <1150000>;
					regulator-always-on;
				};

				vcc_3v3_reg: DCDC_REG3 {
					regulator-name = "DCDC_REG3";
					regulator-min-microvolt = <3300000>;
					regulator-max-microvolt = <3300000>;
					regulator-always-on;
				};

				vddfuse_reg: LDO_REG4 {
					regulator-name = "LDO_REG4";
					regulator-min-microvolt = <2500000>;
					regulator-max-microvolt = <2500000>;
				};

				vddana_reg: LDO_REG5 {
					regulator-name = "LDO_REG5";
					regulator-min-microvolt = <3300000>;
					regulator-max-microvolt = <3300000>;
					regulator-always-on;
				};
			};
		};
	};
```

## Documentation/devicetree/bindings/rtc/atmel-rtc.txt
```
* AT91's Real Time Clock (RTC)

Required properties:
  - compatible: Should be "atmel,at91rm9200-rtc"
  - reg: Should contain RTC registers location and length
  - interrupts: Should contain the IRQ line for the RTC

Example:

	rtc@fffffeb0 {
		compatible = "atmel,at91rm9200-rtc";
		reg = <0xfffffeb0 0x30>;
		interrupts = <1 4 7>;
	};
```

## Documentation/devicetree/bindings/sound/atmel-classd.txt
```
* Atmel ClassD driver under ALSA SoC architecture

* Atmel ClassD driver
Required properties:
- compatible
	Should be "atmel,sama5d2-classd".
- reg
	Should contain ClassD registers location and length.
- interrupts
	Should contain the IRQ line for the ClassD.
- dmas
	One DMA specifiers as described in atmel-dma.txt and dma.txt files.
- dma-names
	Must be "tx".
- clock-names
	tuple listing input clock names.
	Required elements: "pclk", "gclk" and "aclk".
- clocks
	phandles to input clocks.

Optional properties:
- pinctrl-names, pinctrl-0
	Please refer to pinctrl-bindings.txt.
- atmel,pwm-type
	PWM modulation type, "single" or "diff".
- atmel,non-overlap-time
	Set non-overlapping time, the unit is nanosecond(ns).
	There are four values,
	<5>, <10>, <15>, <20>, the default value is <10>.
	Non-overlapping will be disabled if not specified.

Example:
classd: classd@fc048000 {
		compatible = "atmel,sama5d2-classd";
		reg = <0xfc048000 0x100>;
		interrupts = <59 IRQ_TYPE_LEVEL_HIGH 7>;
		dmas = <&dma0
			(AT91_XDMAC_DT_MEM_IF(0) | AT91_XDMAC_DT_PER_IF(1)
			| AT91_XDMAC_DT_PERID(47))>;
		dma-names = "tx";
		clocks = <&classd_clk>, <&classd_gclk>, <&audio_pll_pmc>;
		clock-names = "pclk", "gclk", "aclk";

		pinctrl-names = "default";
		pinctrl-0 = <&pinctrl_classd_default>;
		atmel,pwm-type = "diff";
		atmel,non-overlap-time = <10>;
};


* Atmel ASoC driver with ClassD
Required properties:
- compatible
	Should be "atmel,asoc-classd".
- atmel,model
	The user-visible name of this sound complex.
- atmel,audio-platform
	Should be <&classd>.
- atmel,audio-cpu-dai-name
	The name of the CPU DAI in ALSA SoC architecture.
	The format is <classd registers location>.classd.
- atmel,audio-codec
	Should be <&classd>.

Example:
sound {
		compatible = "atmel,asoc-classd";

		atmel,model = "classd @ SAMA5D2-Xplained";
		atmel,audio-platform = <&classd>;
		atmel,audio-cpu-dai-name = "fc048000.classd";
		atmel,audio-codec = <&classd>;
};
```

## Documentation/devicetree/bindings/sound/atmel_ac97c.txt
```
* Atmel AC97 controller

Required properties:
  - compatible: "atmel,atmel_ac97c"
  - reg: Address and length of the register set for the device
  - interrupts: Should contain AC97 interrupt
  - atmel,reset-pin: GPIO for resetting the codec
Optional properties:
  - pinctrl-names, pinctrl-0: Please refer to pinctrl-bindings.txt

Example:
sound@fffa0000 {
	compatible = "atmel,atmel_ac97c";
	pinctrl-names = "default";
	pinctrl-0 = <&pinctrl_ac97>;
	reg = <0xfffa0000 0x4000>;
	interrupts = <18 IRQ_TYPE_LEVEL_HIGH 5>;

	atmel,reset-pin = <&pioC 29 GPIO_ACTIVE_LOW>;
};
```

## Documentation/devicetree/bindings/spi/spi_atmel.txt
```
Atmel SPI device

Required properties:
- compatible : should be "atmel,at91rm9200-spi".
- reg: Address and length of the register set for the device
- interrupts: Should contain macb interrupt
- cs-gpio: Should contain the GPIOs used for chipselect.
- dma-mask: device coherent dma mask.

spi0: spi@f0000000 {
	#address-cells = <1>;
	#size-cells = <0>;
	compatible = "atmel,at91rm9200-spi";
	reg = <0xf0000000 0x100>;
	interrupts = <13 4>;
	cs-gpios = <&pioA 14 0
		    &pioA 7 0 /* conflicts with TXD2 */
		    &pioA 1 0 /* conflicts with RXD0 */
		    &pioB 3 0 /* conflicts with ERXDV */
		   >;
	dma-mask = <0xffffffff>;
	status = "disabled";
};
```

## drivers/hdmi/Kconfig
```kconfig
menuconfig HDMI
	bool "High Definition Multimedia Interface (HDMI) Support"

if HDMI

config HDMI_SII902x
	tristate "Silicon Image sii902x HDMI support"

config SND_SOC_SII9022
	tristate
	depends on HDMI_SII902x

endif
```
